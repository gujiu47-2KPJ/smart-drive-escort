## radar-debug/sdkconfig.defaults
```kconfig
# MS60-1211S80M (AT6010) 雷达调试工程
#
# 与 imu-debug 一样，刻意保持接近 IDF 默认值，只改必要项：
# 这是排查工具，配置越接近默认，出问题时越能确定是硬件/接线的问题。
# 主固件的性能配置见 firmware/sdkconfig.defaults。

CONFIG_IDF_TARGET="esp32s3"

# N16R8：16MB Flash
CONFIG_ESPTOOLPY_FLASHSIZE_16MB=y

CONFIG_FREERTOS_HZ=1000
CONFIG_ESP_MAIN_TASK_STACK_SIZE=4096

# 串口：UART0 115200（雷达自己走 UART1，默认 921600）
CONFIG_ESP_CONSOLE_UART_DEFAULT=y
CONFIG_ESP_CONSOLE_UART_BAUDRATE=115200

CONFIG_LOG_DEFAULT_LEVEL_INFO=y
```
